SECTIONS
{
    __romPos = 0;
    _gp = 0x80097FA8;
    header_ROM_START = __romPos;
    header_VRAM = ADDR(.header);
    .header : AT(header_ROM_START) SUBALIGN(2)
    {
        FILL(0x00000000);
        header_DATA_START = .;
        build/asm/header.o(.data);
        header_DATA_END = .;
        header_DATA_SIZE = ABSOLUTE(header_DATA_END - header_DATA_START);
    }
    __romPos += SIZEOF(.header);
    header_ROM_END = __romPos;
    header_VRAM_END = .;

    main_ROM_START = __romPos;
    main_VRAM = ADDR(.main);
    .main 0x80010000 : AT(main_ROM_START) SUBALIGN(2)
    {
        FILL(0x00000000);
        main_RODATA_START = .;
        build/src/psxsdk/libsnd.o(.rodata);
        build/src/psxsdk/libsnd.o(.rodata);
        build/src/game.o(.rodata);
        build/src/psxsdk/libgs.o(.rodata);
        build/src/psxsdk/libsn.o(.rodata);
        build/src/psxsdk/libapi.o(.rodata);
        build/src/psxsdk/libcard.o(.rodata);
        build/src/psxsdk/libc2.o(.rodata);
        build/src/psxsdk/libc.o(.rodata);
        build/src/psxsdk/libgte.o(.rodata);
        build/src/psxsdk/libcd.o(.rodata);
        build/src/psxsdk/libetc.o(.rodata);
        build/src/psxsdk/libspu.o(.rodata);
        build/src/psxsdk/libsnd.o(.rodata);
        build/src/psxsdk/libsnd.o(.rodata);
        build/src/psxsdk/libsnd.o(.rodata);
        build/src/psxsdk/libsnd.o(.rodata);
        build/src/psxsdk/libsnd.o(.rodata);
        build/src/psxsdk/libsnd.o(.rodata);
        build/src/psxsdk/libsnd.o(.rodata);
        build/src/psxsdk/libsnd.o(.rodata);
        build/src/psxsdk/libsnd.o(.rodata);
        . = ALIGN(., 16);
        main_RODATA_END = .;
        main_RODATA_SIZE = ABSOLUTE(main_RODATA_END - main_RODATA_START);
        main_TEXT_START = .;
        build/src/psxsdk/libsnd.o(.text);
        build/src/game.o(.text);
        build/src/psxsdk/libsnd.o(.text);
        build/src/psxsdk/libgs.o(.text);
        build/src/psxsdk/libgs.o(.text);
        build/src/psxsdk/libgs.o(.text);
        build/src/psxsdk/libgs.o(.text);
        build/src/psxsdk/libsnd.o(.text);
        build/src/psxsdk/libsnd.o(.text);
        build/src/psxsdk/libsn.o(.text);
        build/src/psxsdk/libsn.o(.text);
        build/src/psxsdk/libapi.o(.text);
        build/src/psxsdk/libapi.o(.text);
        build/src/psxsdk/libcard.o(.text);
        build/src/psxsdk/libapi.o(.text);
        build/src/psxsdk/libapi.o(.text);
        build/src/psxsdk/libapi.o(.text);
        build/src/psxsdk/libapi.o(.text);
        build/src/psxsdk/libapi.o(.text);
        build/src/psxsdk/libapi.o(.text);
        build/src/psxsdk/libapi.o(.text);
        build/src/psxsdk/libapi.o(.text);
        build/src/psxsdk/libapi.o(.text);
        build/src/psxsdk/libapi.o(.text);
        build/src/psxsdk/libapi.o(.text);
        build/src/psxsdk/libapi.o(.text);
        build/src/psxsdk/libapi.o(.text);
        build/src/psxsdk/libapi.o(.text);
        build/src/psxsdk/libapi.o(.text);
        build/src/psxsdk/libapi.o(.text);
        build/src/psxsdk/libapi.o(.text);
        build/src/psxsdk/libapi.o(.text);
        build/src/psxsdk/libapi.o(.text);
        build/src/psxsdk/libc2.o(.text);
        build/src/psxsdk/libc2.o(.text);
        build/src/psxsdk/libc2.o(.text);
        build/src/psxsdk/libc2.o(.text);
        build/src/psxsdk/libc2.o(.text);
        build/src/psxsdk/libc2.o(.text);
        build/src/psxsdk/libc2.o(.text);
        build/src/psxsdk/libc2.o(.text);
        build/src/psxsdk/libc2.o(.text);
        build/src/psxsdk/libc2.o(.text);
        build/src/psxsdk/libc.o(.text);
        build/src/psxsdk/libcard.o(.text);
        build/src/psxsdk/libcard.o(.text);
        build/src/psxsdk/libcard.o(.text);
        build/src/psxsdk/libcard.o(.text);
        build/src/psxsdk/libsnd.o(.text);
        build/src/psxsdk/libsnd.o(.text);
        build/src/psxsdk/libapi.o(.text);
        build/src/psxsdk/libcard.o(.text);
        build/src/psxsdk/libcard.o(.text);
        build/src/psxsdk/libcard.o(.text);
        build/src/psxsdk/libapi.o(.text);
        build/src/psxsdk/libgte.o(.text);
        build/src/psxsdk/libgte.o(.text);
        build/src/psxsdk/libgte.o(.text);
        build/src/psxsdk/libgte.o(.text);
        build/src/psxsdk/libgte.o(.text);
        build/src/psxsdk/libgte.o(.text);
        build/src/psxsdk/libgte.o(.text);
        build/src/psxsdk/libgte.o(.text);
        build/src/psxsdk/libgte.o(.text);
        build/src/psxsdk/libgte.o(.text);
        build/src/psxsdk/libgte.o(.text);
        build/src/psxsdk/libcd.o(.text);
        build/src/psxsdk/libapi.o(.text);
        build/src/psxsdk/libc2.o(.text);
        build/src/psxsdk/libcd.o(.text);
        build/src/psxsdk/libcd.o(.text);
        build/src/psxsdk/libcd.o(.text);
        build/src/psxsdk/libapi.o(.text);
        build/src/psxsdk/libapi.o(.text);
        build/src/psxsdk/libapi.o(.text);
        build/src/psxsdk/libapi.o(.text);
        build/src/psxsdk/libapi.o(.text);
        build/src/psxsdk/libetc.o(.text);
        build/src/psxsdk/libgs.o(.text);
        build/src/psxsdk/libapi.o(.text);
        build/src/psxsdk/libapi.o(.text);
        build/src/psxsdk/libapi.o(.text);
        build/src/psxsdk/libsnd.o(.text);
        build/src/psxsdk/libsnd.o(.text);
        build/src/psxsdk/libspu.o(.text);
        build/src/psxsdk/libsnd.o(.text);
        build/src/psxsdk/libapi.o(.text);
        build/src/psxsdk/libspu.o(.text);
        build/src/psxsdk/libspu.o(.text);
        build/src/psxsdk/libapi.o(.text);
        . = ALIGN(., 16);
        main_TEXT_END = .;
        main_TEXT_SIZE = ABSOLUTE(main_TEXT_END - main_TEXT_START);
        main_DATA_START = .;
        build/asm/data/117C.data.o(.data);
        build/src/psxsdk/libsnd.o(.data);
        build/src/game.o(.data);
        build/src/psxsdk/libgs.o(.data);
        build/src/psxsdk/libsn.o(.data);
        build/src/psxsdk/libapi.o(.data);
        build/src/psxsdk/libcard.o(.data);
        build/src/psxsdk/libc2.o(.data);
        build/src/psxsdk/libc.o(.data);
        build/src/psxsdk/libgte.o(.data);
        build/src/psxsdk/libcd.o(.data);
        build/src/psxsdk/libetc.o(.data);
        build/src/psxsdk/libspu.o(.data);
        . = ALIGN(., 16);
        main_DATA_END = .;
        main_DATA_SIZE = ABSOLUTE(main_DATA_END - main_DATA_START);
        main_BSS_START = .;
        build/src/psxsdk/libsnd.o(.bss);
        build/src/game.o(.bss);
        build/src/psxsdk/libgs.o(.bss);
        build/src/psxsdk/libsn.o(.bss);
        build/src/psxsdk/libapi.o(.bss);
        build/src/psxsdk/libcard.o(.bss);
        build/src/psxsdk/libc2.o(.bss);
        build/src/psxsdk/libc.o(.bss);
        build/src/psxsdk/libgte.o(.bss);
        build/src/psxsdk/libcd.o(.bss);
        build/src/psxsdk/libetc.o(.bss);
        build/src/psxsdk/libspu.o(.bss);
        . = ALIGN(., 16);
        main_BSS_END = .;
        main_BSS_SIZE = ABSOLUTE(main_BSS_END - main_BSS_START);
    }
    __romPos += SIZEOF(.main);
    __romPos = ALIGN(__romPos, 16);
    . = ALIGN(., 16);
    main_ROM_END = __romPos;
    main_VRAM_END = .;

    /DISCARD/ :
    {
        *(*);
    }
}
