SECTIONS
{
    __romPos = 0;
    _gp = 0x80097FA8;
    header_ROM_START = __romPos;
    header_VRAM = ADDR(.header);
    .header : AT(header_ROM_START) SUBALIGN(2)
    {
        FILL(0x00000000);
        header_DATA_START = .;
        build/us/asm/us/header.o(.data);
        header_DATA_END = .;
        header_DATA_SIZE = ABSOLUTE(header_DATA_END - header_DATA_START);
    }
    __romPos += SIZEOF(.header);
    header_ROM_END = __romPos;
    header_VRAM_END = .;

    main_ROM_START = __romPos;
    main_VRAM = ADDR(.main);
    .main 0x80010000 : AT(main_ROM_START) SUBALIGN(2)
    {
        FILL(0x00000000);
        main_RODATA_START = .;
        build/us/src/us/psxsdk/libsnd.o(.rodata);
        build/us/src/us/psxsdk/libsnd.o(.rodata);
        build/us/src/us/psxsdk/libsnd.o(.rodata);
        build/us/src/us/psxsdk/libsnd.o(.rodata);
        build/us/src/us/psxsdk/libsnd.o(.rodata);
        build/us/src/us/psxsdk/libsnd.o(.rodata);
        build/us/src/us/psxsdk/libsnd.o(.rodata);
        build/us/src/us/psxsdk/libsnd.o(.rodata);
        build/us/src/us/psxsdk/libsnd.o(.rodata);
        build/us/src/us/psxsdk/libsnd.o(.rodata);
        build/us/src/us/psxsdk/libgs.o(.rodata);
        build/us/src/us/psxsdk/libgs.o(.rodata);
        build/us/src/us/psxsdk/libgs.o(.rodata);
        build/us/src/us/psxsdk/libgs.o(.rodata);
        build/us/src/us/psxsdk/libgs.o(.rodata);
        build/us/src/us/psxsdk/libgs.o(.rodata);
        build/us/src/us/psxsdk/libsn.o(.rodata);
        build/us/src/us/psxsdk/libsnd.o(.rodata);
        build/us/src/us/psxsdk/libsn.o(.rodata);
        build/us/src/us/psxsdk/libc2.o(.rodata);
        build/us/src/us/psxsdk/libc2.o(.rodata);
        build/us/src/us/psxsdk/libcard.o(.rodata);
        build/us/src/us/psxsdk/libapi.o(.rodata);
        build/us/src/us/psxsdk/libcd.o(.rodata);
        build/us/src/us/psxsdk/libapi.o(.rodata);
        build/us/src/us/psxsdk/libc2.o(.rodata);
        build/us/src/us/psxsdk/libcd.o(.rodata);
        build/us/src/us/psxsdk/libcd.o(.rodata);
        build/us/src/us/psxsdk/libapi.o(.rodata);
        build/us/src/us/psxsdk/libgs.o(.rodata);
        build/us/src/us/psxsdk/libapi.o(.rodata);
        build/us/src/us/psxsdk/libsnd.o(.rodata);
        build/us/src/us/psxsdk/libapi.o(.rodata);
        build/us/src/us/psxsdk/libspu.o(.rodata);
        build/us/src/us/psxsdk/libspu.o(.rodata);
        build/us/src/us/game.o(.rodata);
        build/us/src/us/psxsdk/libc.o(.rodata);
        build/us/src/us/psxsdk/libpress.o(.rodata);
        build/us/src/us/psxsdk/libgpu.o(.rodata);
        build/us/src/us/psxsdk/libgte.o(.rodata);
        build/us/src/us/psxsdk/libetc.o(.rodata);
        build/us/src/us/psxsdk/libsnd.o(.rodata);
        . = ALIGN(., 16);
        main_RODATA_END = .;
        main_RODATA_SIZE = ABSOLUTE(main_RODATA_END - main_RODATA_START);
        main_TEXT_START = .;
        build/us/src/us/game.o(.text);
        build/us/src/us/psxsdk/libsnd.o(.text);
        build/us/src/us/psxsdk/libsnd.o(.text);
        build/us/src/us/psxsdk/libsnd.o(.text);
        build/us/src/us/psxsdk/libgs.o(.text);
        build/us/src/us/psxsdk/libgs.o(.text);
        build/us/src/us/psxsdk/libgs.o(.text);
        build/us/src/us/psxsdk/libgs.o(.text);
        build/us/src/us/psxsdk/libsnd.o(.text);
        build/us/src/us/psxsdk/libsnd.o(.text);
        build/us/src/us/psxsdk/libsn.o(.text);
        build/us/src/us/psxsdk/libsn.o(.text);
        build/us/src/us/psxsdk/libapi.o(.text);
        build/us/src/us/psxsdk/libapi.o(.text);
        build/us/src/us/psxsdk/libcard.o(.text);
        build/us/src/us/psxsdk/libapi.o(.text);
        build/us/src/us/psxsdk/libapi.o(.text);
        build/us/src/us/psxsdk/libapi.o(.text);
        build/us/src/us/psxsdk/libapi.o(.text);
        build/us/src/us/psxsdk/libapi.o(.text);
        build/us/src/us/psxsdk/libapi.o(.text);
        build/us/src/us/psxsdk/libapi.o(.text);
        build/us/src/us/psxsdk/libapi.o(.text);
        build/us/src/us/psxsdk/libapi.o(.text);
        build/us/src/us/psxsdk/libapi.o(.text);
        build/us/src/us/psxsdk/libapi.o(.text);
        build/us/src/us/psxsdk/libapi.o(.text);
        build/us/src/us/psxsdk/libapi.o(.text);
        build/us/src/us/psxsdk/libapi.o(.text);
        build/us/src/us/psxsdk/libapi.o(.text);
        build/us/src/us/psxsdk/libapi.o(.text);
        build/us/src/us/psxsdk/libapi.o(.text);
        build/us/src/us/psxsdk/libapi.o(.text);
        build/us/src/us/psxsdk/libapi.o(.text);
        build/us/src/us/psxsdk/libc2.o(.text);
        build/us/src/us/psxsdk/libc2.o(.text);
        build/us/src/us/psxsdk/libc2.o(.text);
        build/us/src/us/psxsdk/libc2.o(.text);
        build/us/src/us/psxsdk/libc2.o(.text);
        build/us/src/us/psxsdk/libc2.o(.text);
        build/us/src/us/psxsdk/libc2.o(.text);
        build/us/src/us/psxsdk/libc2.o(.text);
        build/us/src/us/psxsdk/libc2.o(.text);
        build/us/src/us/psxsdk/libc2.o(.text);
        build/us/src/us/psxsdk/libc2.o(.text);
        build/us/src/us/psxsdk/libc2.o(.text);
        build/us/src/us/psxsdk/libc2.o(.text);
        build/us/src/us/psxsdk/libc2.o(.text);
        build/us/src/us/psxsdk/libc2.o(.text);
        build/us/src/us/psxsdk/libc2.o(.text);
        build/us/src/us/psxsdk/libc2.o(.text);
        build/us/src/us/psxsdk/libc2.o(.text);
        build/us/src/us/psxsdk/libc.o(.text);
        build/us/src/us/psxsdk/libc2.o(.text);
        build/us/src/us/psxsdk/libc.o(.text);
        build/us/src/us/psxsdk/libcard.o(.text);
        build/us/src/us/psxsdk/libcard.o(.text);
        build/us/src/us/psxsdk/libcard.o(.text);
        build/us/src/us/psxsdk/libcard.o(.text);
        build/us/src/us/psxsdk/libcard.o(.text);
        build/us/src/us/psxsdk/libcard.o(.text);
        build/us/src/us/psxsdk/libsnd.o(.text);
        build/us/src/us/psxsdk/libsnd.o(.text);
        build/us/src/us/psxsdk/libapi.o(.text);
        build/us/src/us/psxsdk/libcard.o(.text);
        build/us/src/us/psxsdk/libcard.o(.text);
        build/us/src/us/psxsdk/libcard.o(.text);
        build/us/src/us/psxsdk/libcard.o(.text);
        build/us/src/us/psxsdk/libpress.o(.text);
        build/us/src/us/psxsdk/libpress.o(.text);
        build/us/src/us/psxsdk/libgpu.o(.text);
        build/us/src/us/psxsdk/libgpu.o(.text);
        build/us/src/us/psxsdk/libgpu.o(.text);
        build/us/src/us/psxsdk/libapi.o(.text);
        build/us/src/us/psxsdk/libgpu.o(.text);
        build/us/src/us/psxsdk/libgte.o(.text);
        build/us/src/us/psxsdk/libgte.o(.text);
        build/us/src/us/psxsdk/libgte.o(.text);
        build/us/src/us/psxsdk/libgte.o(.text);
        build/us/src/us/psxsdk/libgte.o(.text);
        build/us/src/us/psxsdk/libgte.o(.text);
        build/us/src/us/psxsdk/libgte.o(.text);
        build/us/src/us/psxsdk/libgte.o(.text);
        build/us/src/us/psxsdk/libgte.o(.text);
        build/us/src/us/psxsdk/libgte.o(.text);
        build/us/src/us/psxsdk/libgte.o(.text);
        build/us/src/us/psxsdk/libgte.o(.text);
        build/us/src/us/psxsdk/libgte.o(.text);
        build/us/src/us/psxsdk/libgte.o(.text);
        build/us/src/us/psxsdk/libgte.o(.text);
        build/us/src/us/psxsdk/libgte.o(.text);
        build/us/src/us/psxsdk/libcd.o(.text);
        build/us/src/us/psxsdk/libcd.o(.text);
        build/us/src/us/psxsdk/libapi.o(.text);
        build/us/src/us/psxsdk/libcd.o(.text);
        build/us/src/us/psxsdk/libcd.o(.text);
        build/us/src/us/psxsdk/libc2.o(.text);
        build/us/src/us/psxsdk/libcd.o(.text);
        build/us/src/us/psxsdk/libcd.o(.text);
        build/us/src/us/psxsdk/libcd.o(.text);
        build/us/src/us/psxsdk/libcd.o(.text);
        build/us/src/us/psxsdk/libcd.o(.text);
        build/us/src/us/psxsdk/libcd.o(.text);
        build/us/src/us/psxsdk/libcd.o(.text);
        build/us/src/us/psxsdk/libcd.o(.text);
        build/us/src/us/psxsdk/libcd.o(.text);
        build/us/src/us/psxsdk/libcd.o(.text);
        build/us/src/us/psxsdk/libapi.o(.text);
        build/us/src/us/psxsdk/libapi.o(.text);
        build/us/src/us/psxsdk/libapi.o(.text);
        build/us/src/us/psxsdk/libapi.o(.text);
        build/us/src/us/psxsdk/libetc.o(.text);
        build/us/src/us/psxsdk/libetc.o(.text);
        build/us/src/us/psxsdk/libetc.o(.text);
        build/us/src/us/psxsdk/libgs.o(.text);
        build/us/src/us/psxsdk/libapi.o(.text);
        build/us/src/us/psxsdk/libapi.o(.text);
        build/us/src/us/psxsdk/libsn.o(.text);
        build/us/src/us/psxsdk/libapi.o(.text);
        build/us/src/us/psxsdk/libsnd.o(.text);
        build/us/src/us/psxsdk/libsnd.o(.text);
        build/us/src/us/psxsdk/libsnd.o(.text);
        build/us/src/us/psxsdk/libsnd.o(.text);
        build/us/src/us/psxsdk/libsnd.o(.text);
        build/us/src/us/psxsdk/libsnd.o(.text);
        build/us/src/us/psxsdk/libsnd.o(.text);
        build/us/src/us/psxsdk/libsnd.o(.text);
        build/us/src/us/psxsdk/libsnd.o(.text);
        build/us/src/us/psxsdk/libsnd.o(.text);
        build/us/src/us/psxsdk/libsnd.o(.text);
        build/us/src/us/psxsdk/libsnd.o(.text);
        build/us/src/us/psxsdk/libsnd.o(.text);
        build/us/src/us/psxsdk/libsnd.o(.text);
        build/us/src/us/psxsdk/libsnd.o(.text);
        build/us/src/us/psxsdk/libsnd.o(.text);
        build/us/src/us/psxsdk/libsnd.o(.text);
        build/us/src/us/psxsdk/libsnd.o(.text);
        build/us/src/us/psxsdk/libsnd.o(.text);
        build/us/src/us/psxsdk/libsnd.o(.text);
        build/us/src/us/psxsdk/libsnd.o(.text);
        build/us/src/us/psxsdk/libsnd.o(.text);
        build/us/src/us/psxsdk/libsnd.o(.text);
        build/us/src/us/psxsdk/libsnd.o(.text);
        build/us/src/us/psxsdk/libsnd.o(.text);
        build/us/src/us/psxsdk/libsnd.o(.text);
        build/us/src/us/psxsdk/libsnd.o(.text);
        build/us/src/us/psxsdk/libsnd.o(.text);
        build/us/src/us/psxsdk/libsnd.o(.text);
        build/us/src/us/psxsdk/libsnd.o(.text);
        build/us/src/us/psxsdk/libsnd.o(.text);
        build/us/src/us/psxsdk/libsnd.o(.text);
        build/us/src/us/psxsdk/libsnd.o(.text);
        build/us/src/us/psxsdk/libsnd.o(.text);
        build/us/src/us/psxsdk/libsnd.o(.text);
        build/us/src/us/psxsdk/libsnd.o(.text);
        build/us/src/us/psxsdk/libsnd.o(.text);
        build/us/src/us/psxsdk/libsnd.o(.text);
        build/us/src/us/psxsdk/libsnd.o(.text);
        build/us/src/us/psxsdk/libsnd.o(.text);
        build/us/src/us/psxsdk/libsnd.o(.text);
        build/us/src/us/psxsdk/libsnd.o(.text);
        build/us/src/us/psxsdk/libsnd.o(.text);
        build/us/src/us/psxsdk/libsnd.o(.text);
        build/us/src/us/psxsdk/libsnd.o(.text);
        build/us/src/us/psxsdk/libsnd.o(.text);
        build/us/src/us/psxsdk/libsnd.o(.text);
        build/us/src/us/psxsdk/libsnd.o(.text);
        build/us/src/us/psxsdk/libspu.o(.text);
        build/us/src/us/psxsdk/libsnd.o(.text);
        build/us/src/us/psxsdk/libspu.o(.text);
        build/us/src/us/psxsdk/libsnd.o(.text);
        build/us/src/us/psxsdk/libsnd.o(.text);
        build/us/src/us/psxsdk/libsnd.o(.text);
        build/us/src/us/psxsdk/libsnd.o(.text);
        build/us/src/us/psxsdk/libsnd.o(.text);
        build/us/src/us/psxsdk/libsnd.o(.text);
        build/us/src/us/psxsdk/libsnd.o(.text);
        build/us/src/us/psxsdk/libsnd.o(.text);
        build/us/src/us/psxsdk/libsnd.o(.text);
        build/us/src/us/psxsdk/libsnd.o(.text);
        build/us/src/us/psxsdk/libsnd.o(.text);
        build/us/src/us/psxsdk/libsnd.o(.text);
        build/us/src/us/psxsdk/libsnd.o(.text);
        build/us/src/us/psxsdk/libsnd.o(.text);
        build/us/src/us/psxsdk/libsnd.o(.text);
        build/us/src/us/psxsdk/libsnd.o(.text);
        build/us/src/us/psxsdk/libsnd.o(.text);
        build/us/src/us/psxsdk/libsnd.o(.text);
        build/us/src/us/psxsdk/libsnd.o(.text);
        build/us/src/us/psxsdk/libsnd.o(.text);
        build/us/src/us/psxsdk/libsnd.o(.text);
        build/us/src/us/psxsdk/libsnd.o(.text);
        build/us/src/us/psxsdk/libsnd.o(.text);
        build/us/src/us/psxsdk/libsnd.o(.text);
        build/us/src/us/psxsdk/libsnd.o(.text);
        build/us/src/us/psxsdk/libsnd.o(.text);
        build/us/src/us/psxsdk/libsnd.o(.text);
        build/us/src/us/psxsdk/libsnd.o(.text);
        build/us/src/us/psxsdk/libsnd.o(.text);
        build/us/src/us/psxsdk/libsnd.o(.text);
        build/us/src/us/psxsdk/libsnd.o(.text);
        build/us/src/us/psxsdk/libsnd.o(.text);
        build/us/src/us/psxsdk/libsnd.o(.text);
        build/us/src/us/psxsdk/libsnd.o(.text);
        build/us/src/us/psxsdk/libsnd.o(.text);
        build/us/src/us/psxsdk/libsnd.o(.text);
        build/us/src/us/psxsdk/libsnd.o(.text);
        build/us/src/us/psxsdk/libsnd.o(.text);
        build/us/src/us/psxsdk/libsnd.o(.text);
        build/us/src/us/psxsdk/libsnd.o(.text);
        build/us/src/us/psxsdk/libsnd.o(.text);
        build/us/src/us/psxsdk/libsnd.o(.text);
        build/us/src/us/psxsdk/libspu.o(.text);
        build/us/src/us/psxsdk/libspu.o(.text);
        build/us/src/us/psxsdk/libspu.o(.text);
        build/us/src/us/psxsdk/libspu.o(.text);
        build/us/src/us/psxsdk/libapi.o(.text);
        build/us/src/us/psxsdk/libspu.o(.text);
        build/us/src/us/psxsdk/libspu.o(.text);
        build/us/src/us/psxsdk/libspu.o(.text);
        build/us/src/us/psxsdk/libspu.o(.text);
        build/us/src/us/psxsdk/libspu.o(.text);
        build/us/src/us/psxsdk/libspu.o(.text);
        build/us/src/us/psxsdk/libspu.o(.text);
        build/us/src/us/psxsdk/libspu.o(.text);
        build/us/src/us/psxsdk/libspu.o(.text);
        build/us/src/us/psxsdk/libspu.o(.text);
        build/us/src/us/psxsdk/libapi.o(.text);
        build/us/src/us/psxsdk/libspu.o(.text);
        build/us/src/us/psxsdk/libspu.o(.text);
        build/us/src/us/psxsdk/libspu.o(.text);
        build/us/src/us/psxsdk/libspu.o(.text);
        build/us/src/us/psxsdk/libspu.o(.text);
        build/us/src/us/psxsdk/libspu.o(.text);
        build/us/src/us/psxsdk/libspu.o(.text);
        build/us/src/us/psxsdk/libspu.o(.text);
        . = ALIGN(., 16);
        main_TEXT_END = .;
        main_TEXT_SIZE = ABSOLUTE(main_TEXT_END - main_TEXT_START);
        main_DATA_START = .;
        build/us/src/us/psxsdk/libsnd.o(.data);
        build/us/src/us/psxsdk/libgs.o(.data);
        build/us/src/us/psxsdk/libsn.o(.data);
        build/us/src/us/psxsdk/libc2.o(.data);
        build/us/src/us/psxsdk/libcard.o(.data);
        build/us/src/us/psxsdk/libapi.o(.data);
        build/us/src/us/psxsdk/libcd.o(.data);
        build/us/src/us/psxsdk/libspu.o(.data);
        build/us/src/us/game.o(.data);
        build/us/src/us/psxsdk/libc.o(.data);
        build/us/src/us/psxsdk/libpress.o(.data);
        build/us/src/us/psxsdk/libgpu.o(.data);
        build/us/src/us/psxsdk/libgte.o(.data);
        build/us/src/us/psxsdk/libetc.o(.data);
        build/us/asm/us/data/674E0.data.o(.data);
        . = ALIGN(., 16);
        main_DATA_END = .;
        main_DATA_SIZE = ABSOLUTE(main_DATA_END - main_DATA_START);
        main_BSS_START = .;
        build/us/src/us/psxsdk/libsnd.o(.bss);
        build/us/src/us/psxsdk/libgs.o(.bss);
        build/us/src/us/psxsdk/libsn.o(.bss);
        build/us/src/us/psxsdk/libc2.o(.bss);
        build/us/src/us/psxsdk/libcard.o(.bss);
        build/us/src/us/psxsdk/libapi.o(.bss);
        build/us/src/us/psxsdk/libcd.o(.bss);
        build/us/src/us/psxsdk/libspu.o(.bss);
        build/us/src/us/game.o(.bss);
        build/us/src/us/psxsdk/libc.o(.bss);
        build/us/src/us/psxsdk/libpress.o(.bss);
        build/us/src/us/psxsdk/libgpu.o(.bss);
        build/us/src/us/psxsdk/libgte.o(.bss);
        build/us/src/us/psxsdk/libetc.o(.bss);
        . = ALIGN(., 16);
        main_BSS_END = .;
        main_BSS_SIZE = ABSOLUTE(main_BSS_END - main_BSS_START);
    }
    __romPos += SIZEOF(.main);
    __romPos = ALIGN(__romPos, 16);
    . = ALIGN(., 16);
    main_ROM_END = __romPos;
    main_VRAM_END = .;

    /DISCARD/ :
    {
        *(*);
    }
}
