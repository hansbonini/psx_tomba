SECTIONS
{
    __romPos = 0;
    _gp = 0x80097FA8;
    header_ROM_START = __romPos;
    header_VRAM = ADDR(.header);
    .header : AT(header_ROM_START) SUBALIGN(2)
    {
        FILL(0x00000000);
        header_DATA_START = .;
        build/scus_942.36/asm/scus_942.36/header.o(.data);
        header_DATA_END = .;
        header_DATA_SIZE = ABSOLUTE(header_DATA_END - header_DATA_START);
    }
    __romPos += SIZEOF(.header);
    header_ROM_END = __romPos;
    header_VRAM_END = .;

    main_ROM_START = __romPos;
    main_VRAM = ADDR(.main);
    .main 0x80010000 : AT(main_ROM_START) SUBALIGN(2)
    {
        FILL(0x00000000);
        main_RODATA_START = .;
        build/scus_942.36/src/scus_942.36/psxsdk/libsnd.o(.rodata);
        build/scus_942.36/src/scus_942.36/psxsdk/libsnd.o(.rodata);
        build/scus_942.36/src/scus_942.36/psxsdk/libsnd.o(.rodata);
        build/scus_942.36/src/scus_942.36/psxsdk/libsnd.o(.rodata);
        build/scus_942.36/src/scus_942.36/psxsdk/libsnd.o(.rodata);
        build/scus_942.36/src/scus_942.36/psxsdk/libsnd.o(.rodata);
        build/scus_942.36/src/scus_942.36/psxsdk/libsnd.o(.rodata);
        build/scus_942.36/src/scus_942.36/psxsdk/libsnd.o(.rodata);
        build/scus_942.36/src/scus_942.36/psxsdk/libsnd.o(.rodata);
        build/scus_942.36/src/scus_942.36/psxsdk/libsnd.o(.rodata);
        build/scus_942.36/src/scus_942.36/psxsdk/libgs.o(.rodata);
        build/scus_942.36/src/scus_942.36/psxsdk/libgs.o(.rodata);
        build/scus_942.36/src/scus_942.36/psxsdk/libgs.o(.rodata);
        build/scus_942.36/src/scus_942.36/psxsdk/libgs.o(.rodata);
        build/scus_942.36/src/scus_942.36/psxsdk/libgs.o(.rodata);
        build/scus_942.36/src/scus_942.36/psxsdk/libgs.o(.rodata);
        build/scus_942.36/src/scus_942.36/psxsdk/libsn.o(.rodata);
        build/scus_942.36/src/scus_942.36/psxsdk/libsnd.o(.rodata);
        build/scus_942.36/src/scus_942.36/psxsdk/libsn.o(.rodata);
        build/scus_942.36/src/scus_942.36/psxsdk/libc2.o(.rodata);
        build/scus_942.36/src/scus_942.36/psxsdk/libc2.o(.rodata);
        build/scus_942.36/src/scus_942.36/psxsdk/libcard.o(.rodata);
        build/scus_942.36/src/scus_942.36/psxsdk/libapi.o(.rodata);
        build/scus_942.36/src/scus_942.36/psxsdk/libcd.o(.rodata);
        build/scus_942.36/src/scus_942.36/psxsdk/libapi.o(.rodata);
        build/scus_942.36/src/scus_942.36/psxsdk/libc2.o(.rodata);
        build/scus_942.36/src/scus_942.36/psxsdk/libcd.o(.rodata);
        build/scus_942.36/src/scus_942.36/psxsdk/libc.o(.rodata);
        build/scus_942.36/src/scus_942.36/psxsdk/libgte.o(.rodata);
        build/scus_942.36/src/scus_942.36/psxsdk/libetc.o(.rodata);
        build/scus_942.36/src/scus_942.36/psxsdk/libspu.o(.rodata);
        build/scus_942.36/src/scus_942.36/psxsdk/libapi.o(.rodata);
        build/scus_942.36/src/scus_942.36/psxsdk/libgs.o(.rodata);
        build/scus_942.36/src/scus_942.36/psxsdk/libapi.o(.rodata);
        build/scus_942.36/src/scus_942.36/psxsdk/libsnd.o(.rodata);
        build/scus_942.36/src/scus_942.36/psxsdk/libapi.o(.rodata);
        build/scus_942.36/src/scus_942.36/psxsdk/libapi.o(.rodata);
        build/scus_942.36/src/scus_942.36/psxsdk/libsnd.o(.rodata);
        . = ALIGN(., 16);
        main_RODATA_END = .;
        main_RODATA_SIZE = ABSOLUTE(main_RODATA_END - main_RODATA_START);
        main_TEXT_START = .;
        build/scus_942.36/src/scus_942.36/psxsdk/libsnd.o(.text);
        build/scus_942.36/src/scus_942.36/psxsdk/libsnd.o(.text);
        build/scus_942.36/src/scus_942.36/psxsdk/libgs.o(.text);
        build/scus_942.36/src/scus_942.36/psxsdk/libgs.o(.text);
        build/scus_942.36/src/scus_942.36/psxsdk/libgs.o(.text);
        build/scus_942.36/src/scus_942.36/psxsdk/libgs.o(.text);
        build/scus_942.36/src/scus_942.36/psxsdk/libsnd.o(.text);
        build/scus_942.36/src/scus_942.36/psxsdk/libsnd.o(.text);
        build/scus_942.36/src/scus_942.36/psxsdk/libsn.o(.text);
        build/scus_942.36/src/scus_942.36/psxsdk/libsn.o(.text);
        build/scus_942.36/src/scus_942.36/psxsdk/libapi.o(.text);
        build/scus_942.36/src/scus_942.36/psxsdk/libapi.o(.text);
        build/scus_942.36/src/scus_942.36/psxsdk/libcard.o(.text);
        build/scus_942.36/src/scus_942.36/psxsdk/libapi.o(.text);
        build/scus_942.36/src/scus_942.36/psxsdk/libapi.o(.text);
        build/scus_942.36/src/scus_942.36/psxsdk/libapi.o(.text);
        build/scus_942.36/src/scus_942.36/psxsdk/libapi.o(.text);
        build/scus_942.36/src/scus_942.36/psxsdk/libapi.o(.text);
        build/scus_942.36/src/scus_942.36/psxsdk/libapi.o(.text);
        build/scus_942.36/src/scus_942.36/psxsdk/libapi.o(.text);
        build/scus_942.36/src/scus_942.36/psxsdk/libapi.o(.text);
        build/scus_942.36/src/scus_942.36/psxsdk/libapi.o(.text);
        build/scus_942.36/src/scus_942.36/psxsdk/libapi.o(.text);
        build/scus_942.36/src/scus_942.36/psxsdk/libapi.o(.text);
        build/scus_942.36/src/scus_942.36/psxsdk/libapi.o(.text);
        build/scus_942.36/src/scus_942.36/psxsdk/libapi.o(.text);
        build/scus_942.36/src/scus_942.36/psxsdk/libapi.o(.text);
        build/scus_942.36/src/scus_942.36/psxsdk/libapi.o(.text);
        build/scus_942.36/src/scus_942.36/psxsdk/libapi.o(.text);
        build/scus_942.36/src/scus_942.36/psxsdk/libapi.o(.text);
        build/scus_942.36/src/scus_942.36/psxsdk/libapi.o(.text);
        build/scus_942.36/src/scus_942.36/psxsdk/libapi.o(.text);
        build/scus_942.36/src/scus_942.36/psxsdk/libc2.o(.text);
        build/scus_942.36/src/scus_942.36/psxsdk/libc2.o(.text);
        build/scus_942.36/src/scus_942.36/psxsdk/libc2.o(.text);
        build/scus_942.36/src/scus_942.36/psxsdk/libc2.o(.text);
        build/scus_942.36/src/scus_942.36/psxsdk/libc2.o(.text);
        build/scus_942.36/src/scus_942.36/psxsdk/libc2.o(.text);
        build/scus_942.36/src/scus_942.36/psxsdk/libc2.o(.text);
        build/scus_942.36/src/scus_942.36/psxsdk/libc2.o(.text);
        build/scus_942.36/src/scus_942.36/psxsdk/libc2.o(.text);
        build/scus_942.36/src/scus_942.36/psxsdk/libc2.o(.text);
        build/scus_942.36/src/scus_942.36/psxsdk/libc.o(.text);
        build/scus_942.36/src/scus_942.36/psxsdk/libcard.o(.text);
        build/scus_942.36/src/scus_942.36/psxsdk/libcard.o(.text);
        build/scus_942.36/src/scus_942.36/psxsdk/libcard.o(.text);
        build/scus_942.36/src/scus_942.36/psxsdk/libcard.o(.text);
        build/scus_942.36/src/scus_942.36/psxsdk/libsnd.o(.text);
        build/scus_942.36/src/scus_942.36/psxsdk/libsnd.o(.text);
        build/scus_942.36/src/scus_942.36/psxsdk/libapi.o(.text);
        build/scus_942.36/src/scus_942.36/psxsdk/libcard.o(.text);
        build/scus_942.36/src/scus_942.36/psxsdk/libcard.o(.text);
        build/scus_942.36/src/scus_942.36/psxsdk/libcard.o(.text);
        build/scus_942.36/src/scus_942.36/psxsdk/libapi.o(.text);
        build/scus_942.36/src/scus_942.36/psxsdk/libgte.o(.text);
        build/scus_942.36/src/scus_942.36/psxsdk/libgte.o(.text);
        build/scus_942.36/src/scus_942.36/psxsdk/libgte.o(.text);
        build/scus_942.36/src/scus_942.36/psxsdk/libgte.o(.text);
        build/scus_942.36/src/scus_942.36/psxsdk/libgte.o(.text);
        build/scus_942.36/src/scus_942.36/psxsdk/libgte.o(.text);
        build/scus_942.36/src/scus_942.36/psxsdk/libgte.o(.text);
        build/scus_942.36/src/scus_942.36/psxsdk/libgte.o(.text);
        build/scus_942.36/src/scus_942.36/psxsdk/libgte.o(.text);
        build/scus_942.36/src/scus_942.36/psxsdk/libgte.o(.text);
        build/scus_942.36/src/scus_942.36/psxsdk/libgte.o(.text);
        build/scus_942.36/src/scus_942.36/psxsdk/libcd.o(.text);
        build/scus_942.36/src/scus_942.36/psxsdk/libapi.o(.text);
        build/scus_942.36/src/scus_942.36/psxsdk/libc2.o(.text);
        build/scus_942.36/src/scus_942.36/psxsdk/libcd.o(.text);
        build/scus_942.36/src/scus_942.36/psxsdk/libcd.o(.text);
        build/scus_942.36/src/scus_942.36/psxsdk/libcd.o(.text);
        build/scus_942.36/src/scus_942.36/psxsdk/libapi.o(.text);
        build/scus_942.36/src/scus_942.36/psxsdk/libapi.o(.text);
        build/scus_942.36/src/scus_942.36/psxsdk/libapi.o(.text);
        build/scus_942.36/src/scus_942.36/psxsdk/libapi.o(.text);
        build/scus_942.36/src/scus_942.36/psxsdk/libapi.o(.text);
        build/scus_942.36/src/scus_942.36/psxsdk/libetc.o(.text);
        build/scus_942.36/src/scus_942.36/psxsdk/libgs.o(.text);
        build/scus_942.36/src/scus_942.36/psxsdk/libapi.o(.text);
        build/scus_942.36/src/scus_942.36/psxsdk/libapi.o(.text);
        build/scus_942.36/src/scus_942.36/psxsdk/libapi.o(.text);
        build/scus_942.36/src/scus_942.36/psxsdk/libsnd.o(.text);
        build/scus_942.36/src/scus_942.36/psxsdk/libsnd.o(.text);
        build/scus_942.36/src/scus_942.36/psxsdk/libspu.o(.text);
        build/scus_942.36/src/scus_942.36/psxsdk/libsnd.o(.text);
        build/scus_942.36/src/scus_942.36/psxsdk/libapi.o(.text);
        build/scus_942.36/src/scus_942.36/psxsdk/libspu.o(.text);
        build/scus_942.36/src/scus_942.36/psxsdk/libspu.o(.text);
        build/scus_942.36/src/scus_942.36/psxsdk/libapi.o(.text);
        . = ALIGN(., 16);
        main_TEXT_END = .;
        main_TEXT_SIZE = ABSOLUTE(main_TEXT_END - main_TEXT_START);
        main_DATA_START = .;
        build/scus_942.36/src/scus_942.36/psxsdk/libsnd.o(.data);
        build/scus_942.36/src/scus_942.36/psxsdk/libgs.o(.data);
        build/scus_942.36/src/scus_942.36/psxsdk/libsn.o(.data);
        build/scus_942.36/src/scus_942.36/psxsdk/libc2.o(.data);
        build/scus_942.36/src/scus_942.36/psxsdk/libcard.o(.data);
        build/scus_942.36/src/scus_942.36/psxsdk/libapi.o(.data);
        build/scus_942.36/src/scus_942.36/psxsdk/libcd.o(.data);
        build/scus_942.36/src/scus_942.36/psxsdk/libc.o(.data);
        build/scus_942.36/src/scus_942.36/psxsdk/libgte.o(.data);
        build/scus_942.36/src/scus_942.36/psxsdk/libetc.o(.data);
        build/scus_942.36/src/scus_942.36/psxsdk/libspu.o(.data);
        . = ALIGN(., 16);
        main_DATA_END = .;
        main_DATA_SIZE = ABSOLUTE(main_DATA_END - main_DATA_START);
        main_BSS_START = .;
        build/scus_942.36/src/scus_942.36/psxsdk/libsnd.o(.bss);
        build/scus_942.36/src/scus_942.36/psxsdk/libgs.o(.bss);
        build/scus_942.36/src/scus_942.36/psxsdk/libsn.o(.bss);
        build/scus_942.36/src/scus_942.36/psxsdk/libc2.o(.bss);
        build/scus_942.36/src/scus_942.36/psxsdk/libcard.o(.bss);
        build/scus_942.36/src/scus_942.36/psxsdk/libapi.o(.bss);
        build/scus_942.36/src/scus_942.36/psxsdk/libcd.o(.bss);
        build/scus_942.36/src/scus_942.36/psxsdk/libc.o(.bss);
        build/scus_942.36/src/scus_942.36/psxsdk/libgte.o(.bss);
        build/scus_942.36/src/scus_942.36/psxsdk/libetc.o(.bss);
        build/scus_942.36/src/scus_942.36/psxsdk/libspu.o(.bss);
        . = ALIGN(., 16);
        main_BSS_END = .;
        main_BSS_SIZE = ABSOLUTE(main_BSS_END - main_BSS_START);
    }
    __romPos += SIZEOF(.main);
    __romPos = ALIGN(__romPos, 16);
    . = ALIGN(., 16);
    main_ROM_END = __romPos;
    main_VRAM_END = .;

    /DISCARD/ :
    {
        *(*);
    }
}
